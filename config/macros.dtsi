macro_ctrl_alt_n: macro_ctrl_alt_n{
compatible = "zmk,behavior-macro";
label = "macro_ctrl_alt_n";
#binding-cells = <0>;
bindings = <&kp LCTRL>, <&kp LEFT_ALT>, <&kp N>;
};
macro_ctrl_alt_m: macro_ctrl_alt_m{
compatible = "zmk,behavior-macro";
label = "macro_ctrl_alt_m";
#binding-cells = <0>;
bindings = <&kp LCTRL>, <&kp LEFT_ALT>, <&kp M>;
};